## boards/shields/dmhuisma/Kconfig.defconfig
```kconfig
#
# Right
#

if SHIELD_DMHUISMA_RIGHT

# Name must be less than 16 characters long!
config ZMK_KEYBOARD_NAME
    default "Dmhuisma KB"

config ZMK_SPLIT_ROLE_CENTRAL
    default y

# Set this to the number of peripherals your dongle will have.
# For a unibody, this would be 1. If you have left and right halves, set it to 2, etc.
config ZMK_SPLIT_BLE_CENTRAL_PERIPHERALS
    default 1

# Set this to ZMK_SPLIT_BLE_CENTRAL_PERIPHERALS + your desired number of BT profiles (default is 5)
config BT_MAX_CONN
    default 6

# Set this to the same number as BT_MAX_CONN
config BT_MAX_PAIRED
    default 6

endif

#
# Left
#

if SHIELD_DMHUISMA_LEFT

endif

#
# Any
#

if SHIELD_DMHUISMA_LEFT || SHIELD_DMHUISMA_RIGHT

config ZMK_SPLIT
    default y

endif
```

## boards/shields/dmhuisma/Kconfig.shield
```kconfig
# No whitespace after the comma or in your part name!
config SHIELD_DMHUISMA_LEFT
    def_bool $(shields_list_contains,dmhuisma_left)

# No whitespace after the comma or in your part name!
config SHIELD_MY_DMHUISMA_RIGHT
    def_bool $(shields_list_contains,dmhuisma_right)
```

## config/west.yml
```yaml
manifest:
  remotes:
    - name: zmkfirmware
      url-base: https://github.com/zmkfirmware
    # Additional modules containing boards/shields/custom code can be listed here as well
    # See https://docs.zephyrproject.org/3.2.0/develop/west/manifest.html#projects
    - name: dmhuisma
      url-base: https://github.com/dmhuisma
    - name: AYM1607
      url-base: https://github.com/AYM1607
    - name: nuovotaka
      url-base: https://github.com/nuovotaka
  projects:
    - name: zmk
      remote: zmkfirmware
      revision: main
      import: app/west.yml
    - name: zmk-driver-azoteq-iqs5xx
      remote: AYM1607
      revision: main
    - name: nice-view-battery-peripheral
      remote: dmhuisma
      revision: zmk_0.4
    - name: zmk_arbitrary_split_data_channel
      remote: dmhuisma
      revision: main
    - name: zmk-split-status-relay
      remote: dmhuisma
      revision: main
    - name: zmk-pointing-acceleration-alpha
      remote: nuovotaka
      revision: main
  self:
    path: config
```
